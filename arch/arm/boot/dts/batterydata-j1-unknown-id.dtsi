	qcom,J1-unknown-id-batterydata {
	qcom,fcc-mah = <1800>;
	qcom,default-rbatt-mohm = <172>;
	qcom,rbatt-capacitive-mohm = <0>;
	qcom,flat-ocv-threshold-uv = <3800000>;
	qcom,max-voltage-uv = <4200000>;
	qcom,v-cutoff-uv = <3000000>;
	qcom,chg-term-ua = <100000>;
	qcom,batt-id-kohm = <10>;
	htc,capacity = <1800>;
	htc,batt_id = <255>;
	htc,id_raw_min = <(-1)>;
	htc,id_raw_max = <(-1)>;
	htc,type = <0>;
	htc,model_name = "UNKNOWN";

	qcom,fcc-temp-lut {
		qcom,lut-col-legend = <(-20) 0 25 40 60>;
		qcom,lut-data = <1860 1870 1880 1880 1870>;
	};

	qcom,pc-temp-ocv-lut {
		qcom,lut-col-legend = <(-20) 0 25 40 60>;
		qcom,lut-row-legend = <100 95 90 85 80 75 70 65 60 55 50 45 40 35 30 25 20 16 13 11 10 9 8 7 6 5 4 3 2 1 0>;
		qcom,lut-data = <4340 4337 4332 4326 4319>,
				<4223 4245 4248 4247 4243>,
				<4153 4185 4190 4189 4186>,
				<4091 4128 4136 4135 4132>,
				<4032 4073 4085 4084 4082>,
				<3976 4018 4036 4037 4035>,
				<3927 3968 3990 3993 3992>,
				<3884 3925 3944 3951 3952>,
				<3848 3888 3901 3909 3911>,
				<3816 3855 3866 3869 3869>,
				<3789 3826 3838 3840 3839>,
				<3765 3802 3816 3817 3816>,
				<3745 3781 3797 3799 3798>,
				<3725 3765 3781 3784 3782>,
				<3706 3752 3766 3765 3759>,
				<3686 3738 3748 3743 3731>,
				<3662 3718 3729 3723 3711>,
				<3639 3698 3709 3703 3690>,
				<3620 3682 3689 3684 3671>,
				<3601 3669 3675 3671 3661>,
				<3589 3663 3671 3669 3658>,
				<3575 3654 3668 3666 3655>,
				<3559 3645 3663 3662 3650>,
				<3540 3634 3655 3654 3642>,
				<3516 3616 3638 3635 3619>,
				<3488 3586 3603 3598 3579>,
				<3449 3537 3552 3547 3528>,
				<3395 3467 3486 3482 3463>,
				<3313 3369 3398 3396 3376>,
				<3181 3229 3270 3267 3245>,
				<3000 3000 3000 3000 3000>;
	};

	qcom,rbatt-sf-lut {
		qcom,lut-col-legend = <(-20) 0 25 40 60>;
		qcom,lut-row-legend = <100 95 90 85 80 75 70 65 60 55 50 45 40 35 30 25 20 16 13 11 10 9 8 7 6 5 4 3 2 1>;
		qcom,lut-data = <300 199 140 140 135>,
				<300 199 140 140 135>,
				<300 199 140 140 135>,
				<300 199 140 140 135>,
				<300 199 140 140 135>,
				<300 199 140 140 135>,
				<300 199 140 140 135>,
				<300 199 140 140 135>,
				<300 199 140 140 135>,
				<300 199 140 140 135>,
				<300 199 140 140 135>,
				<300 199 140 140 135>,
				<300 199 140 140 135>,
				<300 199 140 140 135>,
				<300 199 140 140 135>,
				<300 199 140 140 135>,
				<300 199 140 140 135>,
				<300 199 140 140 135>,
				<300 199 140 140 135>,
				<300 199 140 140 135>,
				<300 199 140 140 135>,
				<300 199 140 140 135>,
				<300 199 140 140 135>,
				<300 199 140 140 135>,
				<300 199 140 140 135>,
				<300 199 140 140 135>,
				<300 199 140 140 135>,
				<300 199 140 140 135>,
				<300 199 140 140 135>,
				<300 199 140 140 135>;
		};
	};
