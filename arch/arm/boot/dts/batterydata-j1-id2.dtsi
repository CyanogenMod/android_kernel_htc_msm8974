	qcom,J1-id2-batterydata {
	qcom,fcc-mah = <1800>;
	qcom,default-rbatt-mohm = <178>;
	qcom,rbatt-capacitive-mohm = <0>;
	qcom,flat-ocv-threshold-uv = <3800000>;
	qcom,max-voltage-uv = <4350000>;
	qcom,v-cutoff-uv = <3000000>;
	qcom,chg-term-ua = <100000>;
	qcom,batt-id-kohm = <22>;
	htc,capacity = <1800>;
	htc,batt_id = <2>;
	htc,id_raw_min = <246>;
	htc,id_raw_max = <510>;
	htc,type = <1>;
	htc,model_name = "B0P6B100";

	qcom,fcc-temp-lut {
		qcom,lut-col-legend = <(-20) 0 25 40 60>;
		qcom,lut-data = <1800 1810 1810 1820 1820>;
	};

	qcom,pc-temp-ocv-lut {
		qcom,lut-col-legend = <(-20) 0 25 40 60>;
		qcom,lut-row-legend = <100 95 90 85 80 75 70 65 60 55 50 45 40 35 30 25 20 16 13 11 10 9 8 7 6 5 4 3 2 1 0>;
		qcom,lut-data = <4343 4340 4335 4330 4321>,
				<4242 4267 4269 4265 4259>,
				<4169 4207 4210 4208 4201>,
				<4110 4151 4154 4152 4147>,
				<4056 4098 4101 4099 4094>,
				<3985 4043 4051 4050 4045>,
				<3924 3987 4005 4005 4000>,
				<3881 3938 3963 3963 3959>,
				<3844 3897 3919 3921 3918>,
				<3819 3861 3872 3875 3872>,
				<3801 3830 3839 3839 3837>,
				<3786 3804 3815 3816 3814>,
				<3770 3784 3796 3796 3795>,
				<3755 3773 3780 3779 3778>,
				<3738 3762 3768 3764 3755>,
				<3720 3746 3754 3746 3732>,
				<3699 3720 3728 3720 3706>,
				<3677 3701 3702 3695 3682>,
				<3657 3688 3682 3675 3665>,
				<3638 3679 3675 3669 3657>,
				<3628 3674 3673 3666 3654>,
				<3617 3669 3670 3664 3651>,
				<3604 3661 3664 3658 3647>,
				<3584 3640 3642 3634 3627>,
				<3562 3619 3619 3608 3591>,
				<3537 3591 3591 3580 3556>,
				<3498 3541 3535 3525 3508>,
				<3449 3478 3472 3463 3439>,
				<3380 3390 3389 3380 3355>,
				<3260 3251 3260 3247 3223>,
				<3000 3000 3000 3000 3000>;
	};

	qcom,rbatt-sf-lut {
		qcom,lut-col-legend = <(-20) 0 25 40 60>;
		qcom,lut-row-legend = <100 95 90 85 80 75 70 65 60 55 50 45 40 35 30 25 20 16 13 11 10 9 8 7 6 5 4 3 2 1>;
		qcom,lut-data = <296 194 133 130 123>,
				<296 194 133 130 123>,
				<296 194 133 130 123>,
				<296 194 133 130 123>,
				<296 194 133 130 123>,
				<296 194 133 130 123>,
				<296 194 133 130 123>,
				<296 194 133 130 123>,
				<296 194 133 130 123>,
				<296 194 133 130 123>,
				<296 194 133 130 123>,
				<296 194 133 130 123>,
				<296 194 133 130 123>,
				<296 194 133 130 123>,
				<296 194 133 130 123>,
				<296 194 133 130 123>,
				<296 194 133 130 123>,
				<296 194 133 130 123>,
				<296 194 133 130 123>,
				<296 194 133 130 123>,
				<296 194 133 130 123>,
				<296 194 133 130 123>,
				<296 194 133 130 123>,
				<296 194 133 130 123>,
				<296 194 133 130 123>,
				<296 194 133 130 123>,
				<296 194 133 130 123>,
				<296 194 133 130 123>,
				<296 194 133 130 123>,
				<296 194 133 130 123>;
		};
	};
