	qcom,EYE-unknown-batterydata {
	qcom,fcc-mah = <2400>;
	qcom,default-rbatt-mohm = <250>;
	qcom,rbatt-capacitive-mohm = <0>;
	qcom,flat-ocv-threshold-uv = <3800000>;
	qcom,max-voltage-uv = <4200000>;
	qcom,v-cutoff-uv = <3000000>;
	qcom,chg-term-ua = <240000>;
	qcom,batt-id-kohm = <10>;
	htc,capacity = <2400>;
	htc,batt_id = <255>;
	htc,id_raw_min = <(-1)>;
	htc,id_raw_max = <(-1)>;
	htc,type = <0>;
	htc,model_name = "UNKNOWN";

	qcom,fcc-temp-lut {
		qcom,lut-col-legend = <(-20) (-10) 0 10 20 30 40>;
		qcom,lut-data = <2290 2390 2420 2440 2450 2450 2450>;
	};

	qcom,pc-temp-ocv-lut {
		qcom,lut-col-legend = <(-20) (-10) 0 10 20 30 40>;
		qcom,lut-row-legend = <100 95 90 85 80 75 70 65 60 55 50 45 40 35 30 25 20 15 10 9 8 7 6 5 4 3 2 1 0>;
		qcom,lut-data = <4330 4335 4340 4340 4345 4345 4345>,
				<4320 4325 4325 4320 4318 4318 4318>,
				<4262 4268 4268 4263 4259 4259 4259>,
				<4207 4212 4212 4208 4202 4202 4202>,
				<4156 4160 4158 4154 4146 4146 4146>,
				<4102 4106 4104 4100 4092 4092 4092>,
				<4057 4068 4065 4063 4050 4050 4050>,
				<3968 3969 3975 3980 3984 3984 3984>,
				<3918 3921 3934 3942 3952 3952 3952>,
				<3892 3892 3894 3898 3899 3899 3899>,
				<3865 3861 3861 3861 3858 3858 3858>,
				<3839 3834 3834 3834 3832 3832 3832>,
				<3816 3813 3813 3813 3810 3810 3810>,
				<3795 3795 3795 3795 3793 3793 3793>,
				<3778 3780 3780 3780 3779 3779 3779>,
				<3764 3770 3770 3770 3766 3759 3759>,
				<3749 3754 3754 3754 3750 3748 3748>,
				<3734 3730 3730 3730 3710 3700 3700>,
				<3720 3710 3707 3698 3696 3696 3696>,
				<3716 3707 3704 3694 3692 3692 3692>,
				<3712 3704 3701 3691 3688 3688 3688>,
				<3709 3701 3698 3687 3684 3684 3684>,
				<3706 3698 3695 3683 3679 3679 3679>,
				<3702 3695 3692 3680 3669 3669 3669>,
				<3620 3610 3610 3600 3590 3590 3590>,
				<3555 3545 3545 3540 3532 3532 3532>,
				<3470 3460 3460 3460 3452 3452 3452>,
				<3340 3340 3340 3340 3334 3334 3334>,
				<3000 3000 3000 3000 3000 3000 3000>;
	};

	qcom,rbatt-sf-lut {
		qcom,lut-col-legend = <(-20) (-10) 0 10 20 30 40>;
		qcom,lut-row-legend = <100 95 90 85 80 75 70 65 60 55 50 45 40 35 30 25 20 15 10 9 8 7 6 5 4 3 2 1 0>;
		qcom,lut-data = <252 232 156 137 88 88 88>,
				<252 232 156 137 88 88 88>,
				<252 232 156 137 88 88 88>,
				<252 232 156 137 88 88 88>,
				<252 232 156 137 88 88 88>,
                                <252 232 156 137 88 88 88>,
				<252 232 156 137 88 88 88>,
                                <252 232 156 137 88 88 88>,
				<252 232 156 137 88 88 88>,
                                <252 232 156 137 88 88 88>,
				<252 232 156 137 88 88 88>,
                                <252 232 156 137 88 88 88>,
				<252 232 156 137 88 88 88>,
                                <252 232 156 137 88 88 88>,
				<252 232 156 137 88 88 88>,
                                <252 232 156 137 88 88 88>,
				<252 232 156 137 88 88 88>,
                                <252 232 156 137 88 88 88>,
				<252 232 156 137 88 88 88>,
                                <252 232 156 137 88 88 88>,
				<252 232 156 137 88 88 88>,
                                <252 232 156 137 88 88 88>,
				<252 232 156 137 88 88 88>,
                                <252 232 156 137 88 88 88>,
				<252 232 156 137 88 88 88>,
                                <252 232 156 137 88 88 88>,
				<252 232 156 137 88 88 88>,
                                <252 232 156 137 88 88 88>,
				<252 232 156 137 88 88 88>;
		};
	};
